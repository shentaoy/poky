## build/conf/bblayers.conf
```bitbake
# POKY_BBLAYERS_CONF_VERSION is increased each time build/conf/bblayers.conf
# changes incompatibly
POKY_BBLAYERS_CONF_VERSION = "2"

BBPATH = "${TOPDIR}"
BBFILES ?= ""

BBLAYERS ?= " \
  /home/allen/repo/bbpg/poky/meta \
  /home/allen/repo/bbpg/poky/meta-poky \
  /home/allen/repo/bbpg/poky/meta-yocto-bsp \
  /home/allen/repo/bbpg/poky/meta-allen \
  "
```

## meta-hello-allen/conf/layer.conf
```bitbake
# We have a conf and classes directory, add to BBPATH
BBPATH .= ":${LAYERDIR}"

# We have recipes-* directories, add to BBFILES
BBFILES += "${LAYERDIR}/recipes-*/*/*.bb \
            ${LAYERDIR}/recipes-*/*/*.bbappend"

BBFILE_COLLECTIONS += "meta-hello-allen"
BBFILE_PATTERN_meta-hello-allen = "^${LAYERDIR}/"
BBFILE_PRIORITY_meta-hello-allen = "6"

LAYERDEPENDS_meta-hello-allen = "core"
LAYERSERIES_COMPAT_meta-hello-allen = "kirkstone"
```
